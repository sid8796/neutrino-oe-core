## meta-formuler/conf/layer.conf
```bitbake
# We have a conf and classes directory, append to BBPATH
BBPATH .= ":${LAYERDIR}"

BBFILES += "${LAYERDIR}/recipes-*/*.bb ${LAYERDIR}/recipes-*/*/*.bb \
            ${LAYERDIR}/recipes-*/*.bbappend ${LAYERDIR}/recipes-*/*/*.bbappend"

BSP-BASE-FORMULER := '${@os.path.normpath("${LAYERDIR}/")}'

BBFILE_COLLECTIONS += "formuler"
BBFILE_PATTERN_formuler = "^${LAYERDIR}/"
BBFILE_PRIORITY_formuler = "6"
LAYERSERIES_COMPAT_formuler = "scarthgap"
LAYERDEPENDS_formuler = "core neutrino"
```

## meta-neutrino/conf/distro/include/neutrino-srcrevs.inc
```bitbake
SRCREV:pn-kernel-module-88x2bu ??= "342c46353b523dee8c61282eb1cab5788c7d3386"
SRCREV:pn-ffmpeg ??= "b48951bd29fbec166428efb5a0e27f51ff98fd84"
SRCREV:pn-libdvbsi++ ??= "f3c40ea6daa94a3bfeeee1ef9381c68629a68b81"
SRCREV:pn-firmware-carl9170 ??= "b2d9309b660816087dbe8ca94f46e5821d549c4a"
SRCREV:pn-firmware-htc7010 ??= "b2d9309b660816087dbe8ca94f46e5821d549c4a"
SRCREV:pn-firmware-htc9271 ??= "b2d9309b660816087dbe8ca94f46e5821d549c4a"
SRCREV:pn-firmware-mt7601u ??= "b2d9309b660816087dbe8ca94f46e5821d549c4a"
SRCREV:pn-firmware-rt2870 ??= "b2d9309b660816087dbe8ca94f46e5821d549c4a"
SRCREV:pn-firmware-rt73 ??= "b2d9309b660816087dbe8ca94f46e5821d549c4a"
SRCREV:pn-firmware-rtl8188eu ??= "b2d9309b660816087dbe8ca94f46e5821d549c4a"
SRCREV:pn-firmware-rtl8192cu ??= "b2d9309b660816087dbe8ca94f46e5821d549c4a"
SRCREV:pn-firmware-rtl8712u ??= "b2d9309b660816087dbe8ca94f46e5821d549c4a"
SRCREV:pn-firmware-rtl8xxxu ??= "b2d9309b660816087dbe8ca94f46e5821d549c4a"
SRCREV:pn-firmware-zd1211 ??= "b2d9309b660816087dbe8ca94f46e5821d549c4a"
```

## meta-neutrino/conf/layer.conf
```bitbake
BBPATH .= ":${LAYERDIR}"
BBFILES += "${LAYERDIR}/recipes-*/*/*.bb ${LAYERDIR}/recipes-*/*/*.bbappend"
BBFILE_COLLECTIONS += "neutrino"
BBFILE_PATTERN_neutrino = "^${LAYERDIR}/"
BBFILE_PRIORITY_neutrino = "9"
LAYERSERIES_COMPAT_neutrino = "scarthgap"
LAYERDEPENDS_neutrino = "core openembedded-layer networking-layer multimedia-layer meta-python"
NEUTRINO_BASE := "${@os.path.normpath('${LAYERDIR}/../')}"
NEUTRINO_BASE[vardepvalue] = "neutrino-oe-core"
LICENSE_PATH += "${LAYERDIR}/licenses"
```

## meta-softcams/conf/layer.conf
```bitbake
BBPATH .= ":${LAYERDIR}"
BBFILES += "${LAYERDIR}/recipes-*/*/*.bb ${LAYERDIR}/recipes-*/*/*.bbappend"
BBFILE_COLLECTIONS += "softcams"
BBFILE_PATTERN_softcams = "^${LAYERDIR}/"
BBFILE_PRIORITY_softcams = "8"
LAYERSERIES_COMPAT_softcams = "scarthgap"
LAYERDEPENDS_softcams = "core openembedded-layer"
```
